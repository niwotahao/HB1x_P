
#include "hal_types.h"
#include "OnBoard.h"
/********************************************************************************************************
*
********************************************************************************************************/
#define RF_TEST_ENTER() 		{P0SEL &= ~(0x04); P0DIR &= ~(0x04); P0INP &= ~(0x04);P2INP &= ~(0X20);} /**< 上拉 */
#define RF_TEST_EXT()		
#define RF_TEST_CLEAR()
#define RF_TEST_PIN()			(P0&0x04)
/********************************************************************************************************
* 
********************************************************************************************************/
void delay_ms(uint8 x);
void delay_us(uint8 x);
void RadioTxTest(void);
void RadioResetTrx(void);
void RfTestProcessEvent(void);
/********************************************************************************************************
*                                               微秒延时
********************************************************************************************************/
void delay_us(uint8 x)
{
    uint16 i;
    for(i=0; i<x; i++)
    {
    }
}
/********************************************************************************************************
*                                               毫秒延时
********************************************************************************************************/
void delay_ms(uint8 x)
{
    uint8 i,k;
    for(i=0; i<x; i++)
    {
      for(k=0;k<5;k++)
      {
        delay_us(111);
      }
    }
}
/********************************************************************************************************
* 
********************************************************************************************************/
void RadioTxTest(void)
{
	/* RF settings SoC: CC2530 */
	P1		  = 0xEE; // port 1 
	P1DIR	  = 0x12; // port 1 direction 
	FRMCTRL0  = 0x43; // frame handling 
	FRMCTRL1  = 0x00; // frame handling 
	FREQCTRL  = 0x60; // controls the rf frequency  28 //2490
    CCACTRL0  = 0xF8;
	FSCAL1	  = 0x00; // tune frequency calibration 
	AGCCTRL1  = 0x15; // agc reference level 
	AGCCTRL2  = 0xFE;
    MDMTEST1  = 0x18; // test register for modem 
	TXFILTCFG = 0x09; // tx filter configuration 
    RFST = 0xE9;
}
/********************************************************************************************************
* 
********************************************************************************************************/
void RadioResetTrx(void)
{
	RFST = 0xEF;
}
/********************************************************************************************************
* 
********************************************************************************************************/
void RfTestProcessEvent(void)
{
    uint8 n=0;
    
	delay_ms(250);
	delay_ms(250);
	RF_TEST_ENTER();
	delay_ms(1);
	if(!RF_TEST_PIN())
	{
		delay_ms(10);
		if(!RF_TEST_PIN())
		{
			RF_TEST_CLEAR();
			RadioTxTest();
			while(1)
			{
				delay_ms(100);n++;
				if(RF_TEST_PIN()||(n >70))
				{
					RadioResetTrx();
					break;
				}
			}
		}
	}
	RF_TEST_EXT();
}